## intellif/buildroot/Config.in
```kconfig
source "$BR2_EXTERNAL_INTELLIF_PATH/package/app_opencv_resize/Config.in"
source "$BR2_EXTERNAL_INTELLIF_PATH/package/app_hello_world/Config.in"
source "$BR2_EXTERNAL_INTELLIF_PATH/package/ko_hello_world/Config.in"
source "$BR2_EXTERNAL_INTELLIF_PATH/package/sdk_drv/Config.in"
source "$BR2_EXTERNAL_INTELLIF_PATH/package/sdk_drv_ko/Config.in"
```

## intellif/buildroot/configs/qemu_intellif_defconfig
```kconfig
BR2_aarch64=y
BR2_TOOLCHAIN_EXTERNAL=y
BR2_TOOLCHAIN_EXTERNAL_CUSTOM=y
BR2_TOOLCHAIN_EXTERNAL_DOWNLOAD=y
BR2_TOOLCHAIN_EXTERNAL_URL="https://mirrors.aliyun.com/armbian-releases/_toolchain/gcc-arm-9.2-2019.12-x86_64-aarch64-none-linux-gnu.tar.xz"
BR2_TOOLCHAIN_EXTERNAL_CUSTOM_PREFIX="aarch64-none-linux-gnu"
BR2_TOOLCHAIN_EXTERNAL_GCC_9=y
BR2_TOOLCHAIN_EXTERNAL_HEADERS_4_20=y
BR2_TOOLCHAIN_EXTERNAL_CUSTOM_GLIBC=y
BR2_TOOLCHAIN_EXTERNAL_CXX=y
BR2_SYSTEM_DHCP="eth0"
BR2_ROOTFS_POST_IMAGE_SCRIPT="$(BR2_EXTERNAL_INTELLIF_PATH)/board/qemu/post-image.sh"
BR2_ROOTFS_POST_SCRIPT_ARGS="$(BR2_DEFCONFIG)"
BR2_LINUX_KERNEL=y
BR2_LINUX_KERNEL_CUSTOM_TARBALL=y
BR2_LINUX_KERNEL_CUSTOM_TARBALL_LOCATION="file://$(BR2_EXTERNAL_INTELLIF_PATH)/tarball/linux.tar"
BR2_LINUX_KERNEL_USE_CUSTOM_CONFIG=y
BR2_LINUX_KERNEL_CUSTOM_CONFIG_FILE="$(BR2_EXTERNAL_INTELLIF_PATH)/board/qemu/aarch64-virt/linux.config"
BR2_LINUX_KERNEL_NEEDS_HOST_OPENSSL=y
BR2_PACKAGE_OPENCV4=y
BR2_PACKAGE_OPENCV4_LIB_IMGCODECS=y
BR2_PACKAGE_OPENCV4_LIB_PHOTO=y
BR2_PACKAGE_OPENCV4_WITH_FFMPEG=y
BR2_PACKAGE_OPENCV4_WITH_JPEG=y
BR2_PACKAGE_OPENCV4_WITH_PNG=y
BR2_PACKAGE_OPENCV4_WITH_PROTOBUF=y
BR2_TARGET_ROOTFS_EXT2=y
BR2_TARGET_ROOTFS_EXT2_4=y
# BR2_TARGET_ROOTFS_TAR is not set
BR2_PACKAGE_KO_HELLO_WORLD=y
```

## intellif/buildroot/package/app_hello_world/Config.in
```kconfig
config BR2_PACKAGE_APP_HELLO_WORLD
    bool "APP_HELLO_WORLD"
    help
        APP_HELLO_WORLD is an hello-world demo package.
```

## intellif/buildroot/package/app_opencv_demo_0/Config.in
```kconfig
config BR2_PACKAGE_APP_OPENCV_DEMO_0
    bool "APP_OPENCV_DEMO_0"
    depends on BR2_PACKAGE_OPENCV4
    help
        APP_OPENCV_DEMO_0 is an demo package for use opencv.
```

## intellif/buildroot/package/app_opencv_resize/Config.in
```kconfig
config BR2_PACKAGE_APP_OPENCV_RESIZE
    bool "APP_OPENCV_DEMO_0"
    depends on BR2_PACKAGE_OPENCV4
    depends on BR2_PACKAGE_OPENCV4_LIB_IMGPROC
    help
        APP_OPENCV_DEMO_0 is an demo package for use opencv.


config BR2_PACKAGE_APP_OPENCV_RESIZE_LOG_LEVEL
    string "Log level for app_opencv_resize"
    default "LOG_LEVEL_INFO"
    help
        Set the log level for app_opencv_resize. Possible values are:
        LOG_LEVEL_INFO, LOG_LEVEL_DEBUG, etc.


config BR2_PACKAGE_APP_OPENCV_RESIZE_BUILD_TYPE
    string "Build type for app_opencv_resize"
    default "Release"
    help
        Set the build type for app_opencv_resize. Possible values are:
        Debug, Release.
```

## intellif/buildroot/package/ko_hello_world/Config.in
```kconfig
config BR2_PACKAGE_KO_HELLO_WORLD
    bool "KO_HELLO_WORLD"
    depends on BR2_LINUX_KERNEL
    help
        KO_HELLO_WORLD is an hello-world demo package for linux kernel module.
```

## intellif/buildroot/package/sdk_drv/Config.in
```kconfig
config BR2_PACKAGE_SDK_DRV
    bool "SDK_DRV"
    help
        SDK_DRV is an sdk driver demo package.
```

## intellif/buildroot/package/sdk_drv_ko/Config.in
```kconfig
config BR2_PACKAGE_SDK_DRV_KO
    bool "SDK_DRV_KO"
    depends on BR2_LINUX_KERNEL
    help
        SDK_DRV_KO is an sdk driver demo package.
```
